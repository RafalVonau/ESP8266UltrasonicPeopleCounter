#include <Arduino.h>
#include <ESP8266WiFi.h>
#include "st7735.h"
#include "bat.h"


#define BAT_0_IMAGE_LEN 18
#define BAT_0_IMAGE_W 1
#define BAT_0_IMAGE_H 18
#define BAT_0_draw(x,y) TFT_drawPixmap(x, y, BAT_0_IMAGE_W, BAT_0_IMAGE_H,BAT_0_IMAGE)

const uint16_t BAT_0_IMAGE[18] PROGMEM = {
	0x3A2A, 0x3CBE, 0x9DEF, 0x9DEF, 0x9DEF, 0x9DEF, 0x9DEF, 0x9DEF, 0x9DEF, 0x9DEF, 0x9DEF, 0x9DEF, 0x9DEF, 0x9DEF, 0x9DEF, 0x9DEF, 0x3CBE, 0x9A32
};



#define BAT_1_IMAGE_LEN 18
#define BAT_1_IMAGE_W 1
#define BAT_1_IMAGE_H 18
#define BAT_1_draw(x,y) TFT_drawPixmap(x, y, BAT_1_IMAGE_W, BAT_1_IMAGE_H,BAT_1_IMAGE)

const uint16_t BAT_1_IMAGE[18] PROGMEM = {
	0x3A2A, 0x3CBE, 0xDA19, 0xDA19, 0xDA19, 0xDA19, 0xDA19, 0xDA19, 0xDA19, 0xDA19, 0xDA19, 0xDA19, 0xDA19, 0xDA19, 0xDA19, 0xDA19, 0x3CBE, 0x9A32
};



#define BAT_END_0_IMAGE_LEN 72
#define BAT_END_0_IMAGE_W 4
#define BAT_END_0_IMAGE_H 18
#define BAT_END_0_draw(x,y) TFT_drawPixmap(x, y, BAT_END_0_IMAGE_W, BAT_END_0_IMAGE_H,BAT_END_0_IMAGE)

const uint16_t BAT_END_0_IMAGE[72] PROGMEM = {
	0x5A2A, 0x1A4B, 0xBCAD, 0x5DE7, 0x5CBE, 0xFCB5, 0xBB5B, 0x7CA5, 0x9DEF, 0x3CBE, 0xFCB5, 0x5A53, 0x9DEF, 0x9DEF, 0x5CBE, 0xBA3A, 0x9DEF, 0x9DEF, 0x1CBE, 0x9A32,
	0x9DEF, 0x9DEF, 0x3CBE, 0x9A32, 0x9DEF, 0x9DEF, 0x3CBE, 0x9A32, 0x9DEF, 0x9DEF, 0x3CBE, 0x9A32, 0x9DEF, 0x9DEF, 0x3CBE, 0x9A32, 0x9DEF, 0x9DEF, 0x3CBE, 0x9A32,
	0x9DEF, 0x9DEF, 0x3CBE, 0x9A32, 0x9DEF, 0x9DEF, 0x3CBE, 0x9A32, 0x9DEF, 0x9DEF, 0x3CBE, 0x9A32, 0x9DEF, 0x9DEF, 0x1CBE, 0x9A32, 0x9DEF, 0x9DEF, 0x5CBE, 0xBA3A,
	0x9DEF, 0x3CBE, 0xFCB5, 0x5A53, 0x5CBE, 0xFCB5, 0xBB5B, 0x7CA5, 0xBA3A, 0x5A53, 0x7CA5, 0x5DE7
};



#define BAT_END_1_IMAGE_LEN 72
#define BAT_END_1_IMAGE_W 4
#define BAT_END_1_IMAGE_H 18
#define BAT_END_1_draw(x,y) TFT_drawPixmap(x, y, BAT_END_1_IMAGE_W, BAT_END_1_IMAGE_H,BAT_END_1_IMAGE)

const uint16_t BAT_END_1_IMAGE[72] PROGMEM = {
	0x5A2A, 0x1A4B, 0xBCAD, 0x5DE7, 0x5CBE, 0xFCB5, 0xBB5B, 0x7CA5, 0x9A32, 0xFC8C, 0xFCB5, 0x5A53, 0xDA19, 0x7A32, 0x5CBE, 0xBA3A, 0xDA19, 0xFA19, 0x1CBE, 0x9A32,
	0xDA19, 0xDA19, 0x3CBE, 0x9A32, 0xDA19, 0xDA19, 0x3CBE, 0x9A32, 0xDA19, 0xDA19, 0x3CBE, 0x9A32, 0xDA19, 0xDA19, 0x3CBE, 0x9A32, 0xDA19, 0xDA19, 0x3CBE, 0x9A32,
	0xDA19, 0xDA19, 0x3CBE, 0x9A32, 0xDA19, 0xDA19, 0x3CBE, 0x9A32, 0xDA19, 0xDA19, 0x3CBE, 0x9A32, 0xDA19, 0xFA19, 0x1CBE, 0x9A32, 0xDA19, 0x7A32, 0x5CBE, 0xBA3A,
	0x7A32, 0xBB84, 0xFCB5, 0x5A53, 0x5CBE, 0xFCB5, 0xBB5B, 0x7CA5, 0xBA3A, 0x5A53, 0x7CA5, 0x5DE7
};



#define BAT_ROUND_IMAGE_LEN 36
#define BAT_ROUND_IMAGE_W 2
#define BAT_ROUND_IMAGE_H 18
#define BAT_ROUND_draw(x,y) TFT_drawPixmap(x, y, BAT_ROUND_IMAGE_W, BAT_ROUND_IMAGE_H,BAT_ROUND_IMAGE)

const uint16_t BAT_ROUND_IMAGE[36] PROGMEM = {
	0x5A2A, 0x5A2A, 0x7DC6, 0x7DC6, 0x3CBE, 0x1A4B, 0xFA42, 0xDA19, 0xFA19, 0xDA19, 0xDA19, 0xDA19, 0xDA19, 0xDA19, 0xDA19, 0xDA19, 0xDA19, 0xDA19, 0xDA19, 0xDA19,
	0xDA19, 0xDA19, 0xDA19, 0xDA19, 0xDA19, 0xDA19, 0xFA19, 0xDA19, 0xDA42, 0xDA19, 0xFCB5, 0xFA42, 0x7DC6, 0x7DC6, 0x5A2A, 0xBA3A
};



#define BAT_START_0_IMAGE_LEN 144
#define BAT_START_0_IMAGE_W 8
#define BAT_START_0_IMAGE_H 18
#define BAT_START_0_draw(x,y) TFT_drawPixmap(x, y, BAT_START_0_IMAGE_W, BAT_START_0_IMAGE_H,BAT_START_0_IMAGE)

const uint16_t BAT_START_0_IMAGE[144] PROGMEM = {
	0x9DEF, 0x9DEF, 0x9DEF, 0x9DEF, 0x9DEF, 0x9DCE, 0xBB5B, 0x5A2A, 0x9DEF, 0x9DEF, 0x9DEF, 0x9DEF, 0x5CC6, 0x9B5B, 0xBCAD, 0x7DC6, 0x9DEF, 0x9DEF, 0x9DEF, 0x9DEF,
	0x7B7C, 0x5C9D, 0x9DC6, 0x9DEF, 0x9DEF, 0x9DEF, 0x9DEF, 0x9DEF, 0xBB63, 0x7DC6, 0x9DEF, 0x9DEF, 0x9DEF, 0x9DEF, 0x9DEF, 0x9DEF, 0xBB5B, 0x9DC6, 0x9DEF, 0x9DEF,
	0x9DEF, 0x9DEF, 0x9DEF, 0x9DEF, 0xBB5B, 0x9DC6, 0x9DEF, 0x9DEF, 0x5DE7, 0xBB84, 0x5A2A, 0xBB84, 0xBB5B, 0x9DC6, 0x9DEF, 0x9DEF, 0x9B7C, 0xDA19, 0xDA19, 0xBB84,
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	0x7DEF, 0x5CC6, 0xDB63, 0xBA3A
};



#define BAT_START_1_IMAGE_LEN 144
#define BAT_START_1_IMAGE_W 8
#define BAT_START_1_IMAGE_H 18
#define BAT_START_1_draw(x,y) TFT_drawPixmap(x, y, BAT_START_1_IMAGE_W, BAT_START_1_IMAGE_H,BAT_START_1_IMAGE)

const uint16_t BAT_START_1_IMAGE[144] PROGMEM = {
	0x9DEF, 0x9DEF, 0x9DEF, 0x9DEF, 0x9DEF, 0x9DCE, 0xBB5B, 0x5A2A, 0x9DEF, 0x9DEF, 0x9DEF, 0x9DEF, 0x5CC6, 0x9B5B, 0xBCAD, 0x7DC6, 0x9DEF, 0x9DEF, 0x9DEF, 0x9DEF,
	0x7B7C, 0x5C9D, 0x3CBE, 0x1A4B, 0x9DEF, 0x9DEF, 0x9DEF, 0x9DEF, 0xBB63, 0x7DC6, 0xFA42, 0xDA19, 0x9DEF, 0x9DEF, 0x9DEF, 0x9DEF, 0xBB5B, 0x9DC6, 0xFA19, 0xDA19,
	0x9DEF, 0x9DEF, 0x9DEF, 0x9DEF, 0xBB5B, 0x9DC6, 0xDA19, 0xDA19, 0x5DE7, 0xBB84, 0x5A2A, 0xBB84, 0xBB5B, 0x9DC6, 0xDA19, 0xDA19, 0x9B7C, 0xDA19, 0xDA19, 0xBB84,
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	0x7DEF, 0x5CC6, 0xDB63, 0xBA3A
};



//===========================================================================================

#define BAT_0_drawH(x,y,w) TFT_drawPixmapH(x, y, w, BAT_0_IMAGE_H,BAT_0_IMAGE)
#define BAT_1_drawH(x,y,w) TFT_drawPixmapH(x, y, w, BAT_1_IMAGE_H,BAT_1_IMAGE)

//===========================================================================================

void Bat::draw()
{
	int x, p, r;
	if (m_needUpdate == 0) return;
	m_needUpdate = 0;
	
	x = m_x;
	/* Oryginal battery size = 38x18px , start = 8px, end = 4px, middle = 26 + 4 = 30 levels*/
	
	if ((m_val == BAT_MAX) || (m_val == BAT_MAX-1)) {
		/* Draw full battery */
		BAT_START_1_draw(x,m_y);x += BAT_START_1_IMAGE_W;
		BAT_1_drawH(x,m_y, 26);x += 26;
		BAT_END_1_draw(x,m_y);
	} else if ((m_val == 0) || (m_val == 1)) {
		/* Draw empty battery */
		BAT_START_0_draw(x,m_y);x += BAT_START_0_IMAGE_W;
		BAT_0_drawH(x,m_y, 26);x += 26;
		BAT_END_0_draw(x,m_y);
	} else {
		/* Draw some proggress */
		p = 25 - m_val;
		if (p<0) p = 0;
		r = 26 - p;
		BAT_START_0_draw(x,m_y);x += BAT_START_0_IMAGE_W;
		if (p>0) {BAT_0_drawH(x, m_y, p); x += p;}
		if (r>1) {BAT_ROUND_draw(x, m_y); x+=2; r-=2;}
		if (r>0) {BAT_1_drawH(x,m_y, r); x += r;}
		BAT_END_1_draw(x,m_y);
	}
}
//===========================================================================================